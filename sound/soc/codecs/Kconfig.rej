## sound/soc/codecs/Kconfig.rej
```kconfig
--- sound/soc/codecs/Kconfig
+++ sound/soc/codecs/Kconfig
@@ -455,6 +455,17 @@
 	help
 	  Texas Instruments 3W Mono Class-D Audio Amplifier
 
+config SOUND_CONTROL_HAX_GPL
+	tristate "wcd93xx sound control hax"
+	default y
+	help
+	  FauxSound WCD93xx chipset sound control hacks
+
+config SOUND_CONTROL_HAX_3_GPL
+	tristate "new wcd93xx sound control hax"
+	default n
+	help
+	  FauxSound WCD93xx chipset sound control hacks 3.0 for deeper hax
 # CONFIG_LGE_AUDIO
 config LGE_AUDIO
 	default y
```
